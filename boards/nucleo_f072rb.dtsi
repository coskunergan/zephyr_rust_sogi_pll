
&adc1 {
	pinctrl-0 = <&adc_in1_pa1>;
	pinctrl-names = "default";
	st,adc-prescaler = <2>;
	status = "okay";
};

&dac1 {
 	pinctrl-0 = <&dac_out1_pa4>;
 	pinctrl-names = "default";	
 	status = "okay";
};

